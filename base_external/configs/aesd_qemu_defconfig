## base_external/configs/aesd_qemu_defconfig
```kconfig
BR2_KERNEL_HEADERS_5_15=y
BR2_ROOTFS_OVERLAY="../base_external/rootfs_overlay"
BR2_LINUX_KERNEL=y
BR2_PACKAGE_AESD_ASSIGNMENTS=y
BR2_PACKAGE_LDD=y
```

## base_external/package/ldd/Config.in
```kconfig
config BR2_PACKAGE_LDD
	bool "ldd"
	depends on BR2_LINUX_KERNEL
	help
	  Includes the Linux kernel modules representing the faulty and
		the scull device driver from LDD book (Linux Device Drivers)
```
